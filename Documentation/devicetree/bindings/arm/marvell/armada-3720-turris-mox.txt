## drivers/net/ethernet/intel/vrx518-pcie/tc/Kconfig
```kconfig
#
# Intel VRX518 TC driver configuration
#
choice
    prompt "Intel(R) VRX518 DSL TC Platform Selection"
    default VRX518_GRX500 if SOC_XRX500
    default VRX518_DC_DP if SOC_XWAY

    config VRX518_GRX500
       depends on VRX518_TC
       bool "GRX500"
       ---help---
       This selection works on intel GRX5XX SoC platform
       It requests datapath library, DMA driver, CBM driver and
       UMT driver support.
       It works without DC_DP function.

    config VRX518_DC_DP
       depends on VRX518_TC
       bool "DC_DP"
       ---help---
       This selection works on any platform which has DC_DP lib.
       It should be able to work on any one of below mode:
       1. fast path
       2. directpath
       3. CPU path

    config VRX518_CPU
       depends on VRX518_TC
       bool "CPU path"
       ---help---
       This selection works on any platform.
       It has no dependency on any other library/function except linux kernel.

       It still requires Intel MEI driver to make VRX518 DSL working.

endchoice
```
