// SPDX-License-Identifier: (GPL-2.0 OR MIT)
/*
 * Device Tree file for the Turris Omnia
 *
 * Copyright (C) 2016 Uwe Kleine-König <uwe@kleine-koenig.org>
 * Copyright (C) 2016 Tomas Hlavacek <tmshlvkc@gmail.com>
 *
 * Schematic available at https://www.turris.cz/doc/_media/rtrom01-schema.pdf
 */

/dts-v1/;

#include "armada-385-turris-omnia.dtsi"

&sfp {
	status = "okay";
};

/* WAN dual-personality port */
&eth2 {
	status = "okay";
	phy-mode = "sgmii";
	managed = "in-band-status";
	sfp = <&sfp>;
};

